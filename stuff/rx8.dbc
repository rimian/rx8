VERSION ""

NS_ :

BS_:

BU_: XXX

BO_ 129 UNKNOWN_129: 4 XXX
BO_ 533 UNKNOWN_533: 8 XXX
BO_ 515 UNKNOWN_515: 7 XXX
BO_ 516 UNKNOWN_516: 1 XXX
BO_ 530 UNKNOWN_530: 7 XXX
BO_ 561 UNKNOWN_561: 5 XXX
BO_ 576 UNKNOWN_576: 8 XXX
BO_ 592 UNKNOWN_592: 8 XXX
BO_ 650 UNKNOWN_650: 1 XXX
BO_ 768 UNKNOWN_768: 1 XXX
BO_ 1072 UNKNOWN_1072: 7 XXX
BO_ 1200 UNKNOWN_1200: 8 XXX
BO_ 1201 UNKNOWN_1201: 8 XXX
BO_ 1584 UNKNOWN_1584: 8 XXX
BO_ 1616 UNKNOWN_1616: 1 XXX

BO_ 513 PCM: 8 XXX
 SG_ RPM : 0|12@0+ (1,0) [0|13000] "rpm" XXX

BO_ 1056 PCM: 7 XXX
 SG_ ENG_TMP : 0|8@0+ (1,0) [0|255] "C" XXX
 SG_ OIL_PRESSURE : 32|8@0+ (1,0) [0|1] "" XXX   # Oil Pressure Signal (5th byte)
 SG_ CEL_EN : 46|1@0+ (1,0) [0|1] "" XXX
 SG_ CEL_FLASH_EN : 47|1@0+ (1,0) [0|1] "" XXX
 SG_ CLNT_EN : 49|1@0+ (1,0) [0|1] "" XXX
 SG_ BATT_EN : 54|1@0+ (1,0) [0|1] "" XXX
 SG_ OIL_EN : 55|1@0+ (1,0) [0|1] "" XXX

CM_ SG_ 513 RPM "Cannot work out conversion factor atm";
CM_ SG_ 1056 CEL_EN "Enable solid check engine lamp";
CM_ SG_ 1056 CEL_FLASH_EN "Enable blinking check engine lamp";
CM_ SG_ 1056 CLNT_EN "Enable coolant light";
CM_ SG_ 1056 BATT_EN "Enable battery light";
CM_ SG_ 1056 OIL_EN "Enable oil pressure light";
